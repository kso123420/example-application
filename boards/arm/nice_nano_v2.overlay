&spi1 {
    status = "okay";
    cs-gpios = <&gpio0 9 GPIO_ACTIVE_LOW>; // NCS pin

    pmw3360@0 {
        compatible = "zephyr,spi-device";
        reg = <0>;
        label = "PMW3360";
        spi-max-frequency = <2000000>;
    };
};
